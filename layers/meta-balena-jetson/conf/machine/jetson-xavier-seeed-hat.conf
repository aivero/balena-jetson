## layers/meta-balena-jetson/conf/machine/jetson-xavier-seeed-hat.conf
```bitbake
#@TYPE: Machine
#@NAME: Nvidia Jetson Xavier NX dev kit with seeed hat board
#@DESCRIPTION: Nvidia Jetson Xavier NX development kit with
#              QSPI+SDcard module (SKU 0000)

MACHINEOVERRIDES = "jetson-xavier:${MACHINE}"
include conf/machine/jetson-xavier-nx-devkit.conf
```
